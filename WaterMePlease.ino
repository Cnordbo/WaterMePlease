/*
	MicroView Arduino Library
	Copyright (C) 2014 GeekAmmo

	This program is free software: you can redistribute it and/or modify
	it under the terms of the GNU General Public License as published by
	the Free Software Foundation, either version 3 of the License, or
	(at your option) any later version.

	This program is distributed in the hope that it will be useful,
	but WITHOUT ANY WARRANTY; without even the implied warranty of
	MERCHANTABILITY or FITNESS FOR A PARTICULAR PURPOSE.  See the
	GNU General Public License for more details.

	You should have received a copy of the GNU General Public License
	along with this program.  If not, see <http://www.gnu.org/licenses/>.
*/
#include <MicroView.h>



unsigned char watercan[2][384] = {
  {
0x00, 0x00, 0x00, 0x00, 0x00, 0x00, 0x00, 0x00, 0x00, 0x00, 0x00, 0x00, 0x00, 0x00, 0x00, 0x00,
0x00, 0x00, 0x00, 0x00, 0x00, 0x00, 0x00, 0x00, 0x00, 0x00, 0x00, 0x00, 0x80, 0x80, 0x40, 0x40,
0x20, 0x20, 0x20, 0x20, 0x20, 0x20, 0x20, 0x20, 0x20, 0x20, 0x40, 0x40, 0x80, 0x80, 0x00, 0x00,
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0x00, 0x00, 0x00, 0x00, 0x00, 0x00, 0x00, 0x00, 0x00, 0x00, 0x00, 0x00, 0x00, 0x00, 0x00, 0x00
},
{
0x00, 0x00, 0x00, 0x00, 0x00, 0x00, 0x00, 0x00, 0x00, 0x00, 0x00, 0x00, 0x00, 0x00, 0x00, 0x00,
0x00, 0x00, 0x00, 0x00, 0x00, 0x00, 0x00, 0x00, 0x00, 0x00, 0x00, 0x00, 0x80, 0x80, 0x40, 0x40,
0x20, 0x20, 0x20, 0x20, 0x20, 0x20, 0x20, 0x20, 0x20, 0x20, 0x40, 0x40, 0x80, 0x80, 0x00, 0x00,
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0x00, 0x00, 0x00, 0x00, 0x00, 0x00, 0x00, 0x00, 0x00, 0x00, 0x00, 0x00, 0x00, 0x00, 0x00, 0x00
}
};

int humidityPercent = 0;
int pumpPin = 3;
int button = 5;
int sensorPowerPin = 6;
unsigned long pumpHasBeenRunningSince = 0;
unsigned long pumpLastRanAt = 0;
unsigned long lastSensorReading = 0;
unsigned long sensorUpdateInterval = 30UL * 1000;
unsigned long pumpShouldRunFor = 60UL * 1000;
unsigned long cooldown = 1 * 60UL * 1000;
bool pumpIsRunning = false;
int currentWatercan = 0;
bool autostart = false;
unsigned long bitmapUpdateIntervalMs = 500;
unsigned long lastBitmapUpdate = 0;
bool firstRun = true;


void setup() {
  Serial.begin(9600);
  pinMode(sensorPowerPin, OUTPUT);
  pinMode(button, INPUT);
  pinMode(pumpPin,OUTPUT);
  digitalWrite(pumpPin, HIGH);
	uView.begin();		// init and start MicroView
	uView.clear(PAGE);	// erase the memory buffer, when next uView.display() is called, the OLED will be cleared.
  currentWatercan = 0;
  Serial.print("Update interval: ");
  Serial.println(sensorUpdateInterval);
  Serial.print("Pump should run for: ");
  Serial.println(pumpShouldRunFor);
  Serial.print("Cooldown: ");
  Serial.println(cooldown);
}

void updateBitmap() {
  Serial.print("Bitmap to load: ");
  Serial.println(currentWatercan);
    uView.clear(PAGE);
    uView.drawBitmap(watercan[currentWatercan]);
    uView.display();
    currentWatercan == 1 ? currentWatercan = 0 : currentWatercan++;
    lastBitmapUpdate = millis();
}

void loop() {  
  unsigned long currentMillis = millis();
  //if (currentMillis % 1000 == 0) {
    Serial.println("--");
    Serial.print("Next sensor Update: ");
    Serial.println((lastSensorReading + sensorUpdateInterval));
    Serial.print("Should update humidity now: ");
    Serial.println((lastSensorReading + sensorUpdateInterval) <= currentMillis ? "true": "false");
    Serial.print("Current Time: ");
    Serial.println(currentMillis);
    Serial.println("--");
    Serial.print("Button is pressed: ");
    Serial.println(digitalRead(button));

  //}
  if ((lastSensorReading + sensorUpdateInterval) <= currentMillis || firstRun) {
    Serial.println("Updating Humidity");
    updateHumidity();
  }
  if (pumpIsRunning && ((lastBitmapUpdate + bitmapUpdateIntervalMs) <= currentMillis)) {
    Serial.println("Updating bitmap");
    updateBitmap();
  }
  if (digitalRead(button) == HIGH) {
    Serial.println("Button is clicked");
    // Failsafe - Abort pumping
    if (pumpIsRunning && autostart) {
      Serial.println("Stopping the pump");
      autostart = false;
      stopPump();
    } else {
      Serial.println("Starting the pump");
      startPump();
    }
    
  } else if (!autostart && pumpIsRunning) {
    stopPump();
  }
  
  if (pumpIsRunning && autostart) {
    unsigned long targetTime = pumpHasBeenRunningSince + pumpShouldRunFor;
    if (targetTime <= currentMillis) {
      Serial.println("Stopping the autostarted pump");
      autostart = false;
      stopPump();
    }
  } else if (humidityPercent < 70) {
    if ((firstRun || ((pumpLastRanAt + cooldown) < currentMillis)) && !pumpIsRunning ) {
      Serial.println("Triggering autostart of pump");
      autostart = true;
      startPump();
    }
    
  }
  
  if (!pumpIsRunning) {
    uView.clear(PAGE);
    uView.setFontType(3);
    uView.setCursor(0,0);
    uView.print(" ");
    uView.print(humidityPercent);
    uView.print("%% ");
    uView.display();
  }
  firstRun = false;
}

void stopPump() {
  pumpLastRanAt = millis();
  digitalWrite(pumpPin,HIGH);
  pumpIsRunning = false;
}

void startPump() {
  pumpIsRunning = true;
  digitalWrite(pumpPin,LOW);
  pumpHasBeenRunningSince = millis();
}

void updateHumidity() {
  digitalWrite(sensorPowerPin, HIGH);
  delay(50);
  int sensor = analogRead(A0);
  humidityPercent = map(sensor,0,800,0,100);
  Serial.println(humidityPercent);
  lastSensorReading = millis();
  digitalWrite(sensorPowerPin, LOW);
}

